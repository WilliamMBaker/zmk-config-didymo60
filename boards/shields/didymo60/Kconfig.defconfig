## boards/shields/didymo60/Kconfig.defconfig
```kconfig
if SHIELD_DIDYMO60_LEFT

config ZMK_BLE
	default y

config ZMK_USB
	default y

config ZMK_KEYBOARD_NAME
    default "didymo60"

config ZMK_SPLIT_ROLE_CENTRAL
    default y

endif

if SHIELD_DIDYMO60_LEFT || SHIELD_DIDYMO60_RIGHT

config ZMK_SPLIT
    default y

endif
```

## boards/shields/didymo60/Kconfig.shield
```kconfig
config SHIELD_DIDYMO60_LEFT
    def_bool $(shields_list_contains,didymo60_left)

config SHIELD_DIDYMO60_RIGHT
    def_bool $(shields_list_contains,didymo60_right)
```
